## boards/others/knx_workshop_tag/Kconfig.defconfig
```kconfig
if BOARD_KNX_WORKSHOP_TAG

config HW_STACK_PROTECTION
	default ARCH_HAS_STACK_PROTECTION

endif
```

## solution/boards/others/knx_workshop_tag/Kconfig.knx_workshop_tag
```kconfig
config BOARD_KNX_WORKSHOP_TAG
	select SOC_NRF54L15_CPUAPP if BOARD_KNX_WORKSHOP_TAG_NRF54L15_CPUAPP
```

## solution/boards/others/knx_workshop_tag/board.yml
```yaml
board:
  name: knx_workshop_tag
  full_name: KNX Workshop Tag
  vendor: others
  socs:
    - name: nrf54l15
```

## solution/sensor/_build/sensor/Kconfig/arch/Kconfig.tmp
```kconfig
# Load Zephyr Arch Kconfig descriptions.
osource "C:/nordic/SDKs/ncs/v3.4.0/zephyr/arch/rx/Kconfig"
osource "C:/nordic/SDKs/ncs/v3.4.0/zephyr/arch/x86/Kconfig"
osource "C:/nordic/SDKs/ncs/v3.4.0/zephyr/arch/xtensa/Kconfig"
osource "C:/nordic/SDKs/ncs/v3.4.0/zephyr/arch/sparc/Kconfig"
osource "C:/nordic/SDKs/ncs/v3.4.0/zephyr/arch/riscv/Kconfig"
osource "C:/nordic/SDKs/ncs/v3.4.0/zephyr/arch/posix/Kconfig"
osource "C:/nordic/SDKs/ncs/v3.4.0/zephyr/arch/openrisc/Kconfig"
osource "C:/nordic/SDKs/ncs/v3.4.0/zephyr/arch/mips/Kconfig"
osource "C:/nordic/SDKs/ncs/v3.4.0/zephyr/arch/arm64/Kconfig"
osource "C:/nordic/SDKs/ncs/v3.4.0/zephyr/arch/arm/Kconfig"
osource "C:/nordic/SDKs/ncs/v3.4.0/zephyr/arch/arc/Kconfig"
```

## solution/sensor/_build/sensor/Kconfig/boards/Kconfig.sysbuild.tmp
```kconfig
# Load Sysbuild board Kconfig descriptions.
osource "C:/nordic/SDKs/ncs/v3.4.0/zephyr/boards/nordic/nrf54l15dk/Kconfig.sysbuild"
```
